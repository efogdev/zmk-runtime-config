## src/Kconfig
```kconfig
config ZMK_RUNTIME_CONFIG
    bool "ZMK Runtime Configuration"
    depends on SETTINGS
    default y

if ZMK_RUNTIME_CONFIG

config ZMK_RUNTIME_CONFIG_MAX_PARAMS
    int "Maximum number of runtime-configurable parameters"
    default 24
    range 1 64

config ZMK_RUNTIME_CONFIG_LRU_CACHE_SIZE
    int "LRU cache size for parameter lookup"
    default 8
    range 1 64

endif # ZMK_RUNTIME_CONFIG

rsource "shell/Kconfig"
```

## src/shell/Kconfig
```kconfig
if SHELL

config ZMK_RUNTIME_CONFIG_SHELL
    bool "Runtime configuration shell commands"
    default y
    depends on ZMK_RUNTIME_CONFIG

endif
```
